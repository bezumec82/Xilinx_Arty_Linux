/*
 * CAUTION: This file is automatically generated by Xilinx.
 * Version:  
 * Today is: Sun Sep 16 23:22:54 2018
*/


/dts-v1/;
/include/ "pl.dtsi"
/ {
	chosen {
		bootargs = "earlycon";
		stdout-path = "serial0:115200n8";
	};
	aliases {
		ethernet0 = &axi_ethernetlite_0;
		serial0 = &axi_uartlite_0;
		spi0 = &axi_quad_spi_flash;
	};
	memory {
		device_type = "memory";
		reg = <0x80000000 0x10000000>;
	};
};
