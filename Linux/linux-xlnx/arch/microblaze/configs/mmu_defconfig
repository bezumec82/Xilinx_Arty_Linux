## Linux/linux-xlnx/arch/microblaze/configs/mmu_defconfig
```kconfig
### Definitions for MICROBLAZE0 ###
CONFIG_NR_CPUS=1
CONFIG_KERNEL_START=0x80000000
CONFIG_KERNEL_BASE_ADDR=0x80000000
CONFIG_XILINX_MICROBLAZE0_FAMILY="artix7"
CONFIG_XILINX_MICROBLAZE0_HW_VER="10.0"
CONFIG_XILINX_MICROBLAZE0_USE_MSR_INSTR=1
CONFIG_XILINX_MICROBLAZE0_USE_PCMP_INSTR=1
CONFIG_XILINX_MICROBLAZE0_USE_BARREL=1
CONFIG_XILINX_MICROBLAZE0_USE_DIV=0
CONFIG_XILINX_MICROBLAZE0_USE_HW_MUL=1
CONFIG_XILINX_MICROBLAZE0_USE_FPU=0
CONFIG_HZ_100=y
CONFIG_HZ=100
CONFIG_MMU=y

### cmd line ###
CONFIG_CMDLINE_BOOL=y
CONFIG_CMDLINE_FORCE=y
CONFIG_CMDLINE="console=ttyUL0,115200 root=/dev/ram rw"

CONFIG_SYSVIPC=y
CONFIG_POSIX_MQUEUE=y
CONFIG_AUDIT=y
CONFIG_IKCONFIG=y
CONFIG_IKCONFIG_PROC=y
CONFIG_SYSFS_DEPRECATED=y
CONFIG_SYSFS_DEPRECATED_V2=y
CONFIG_KALLSYMS_ALL=y
# CONFIG_BASE_FULL is not set
CONFIG_EMBEDDED=y
CONFIG_SLAB=y
CONFIG_MODULES=y
CONFIG_MODULE_UNLOAD=y

CONFIG_HIGHMEM=y

# CONFIG_PCI is not set

CONFIG_NET_VENDOR_MARVELL=y
CONFIG_MARVELL_PHY=y

CONFIG_NET=y
CONFIG_PACKET=y
CONFIG_UNIX=y
CONFIG_INET=y
# CONFIG_IPV6 is not set
# CONFIG_BRIDGE is not set
# CONFIG_WIRELESS is not set

CONFIG_DEVTMPFS=y
CONFIG_DEVTMPFS_MOUNT=y
CONFIG_MTD=y
CONFIG_MTD_CFI=y
CONFIG_MTD_CFI_INTELEXT=y
CONFIG_MTD_CFI_AMDSTD=y

# CONFIG_BLK_DEV_BSG is not set
CONFIG_PARTITION_ADVANCED=y
# CONFIG_EFI_PARTITION is not set


### Init RD ###
CONFIG_BLK_DEV_RAM=y
CONFIG_BLK_DEV_RAM_COUNT=1
CONFIG_BLK_DEV_RAM_SIZE=16384
CONFIG_RD_GZIP=y

CONFIG_NETDEVICES=y
CONFIG_XILINX_EMACLITE=y
CONFIG_XILINX_LL_TEMAC=y

### UART ###
# CONFIG_INPUT is not set
# CONFIG_SERIO is not set
# CONFIG_VT is not set

CONFIG_SERIAL_CORE=y
CONFIG_SERIAL_CORE_CONSOLE=y
CONFIG_SERIAL_8250_CONSOLE=y
CONFIG_SERIAL_8250_NR_UARTS=1
CONFIG_SERIAL_8250_RUNTIME_UARTS=1

CONFIG_SERIAL_OF_PLATFORM=y
CONFIG_SERIAL_UARTLITE=y
CONFIG_SERIAL_UARTLITE_CONSOLE=y

CONFIG_MANUAL_RESET_VECTOR=0x0
CONFIG_KERNEL_START=0xc0000000

# CONFIG_HW_RANDOM is not set
CONFIG_XILINX_HWICAP=y

# CONFIG_I2C is not set
# CONFIG_I2C_XILINX is not set

### SPI ###
CONFIG_SPI=y
CONFIG_SPI_MASTER=y
# CONFIG_SPI_DEBUG is not set
CONFIG_SPI_XILINX=y
# CONFIG_SPI_BITBANG is not set

### GPIO ###
CONFIG_GPIOLIB=y
CONFIG_GPIO_SYSFS=y
CONFIG_GPIO_XILINX=y
# CONFIG_DEBUG_GPIO is not set

# CONFIG_HWMON is not set
CONFIG_WATCHDOG=y
CONFIG_XILINX_WATCHDOG=y

# CONFIG_FB is not set
# CONFIG_FB_XILINX is not set

# CONFIG_USB_SUPPORT is not set

CONFIG_UIO=y
CONFIG_UIO_PDRV_GENIRQ=y
CONFIG_UIO_DMEM_GENIRQ=y

### FS ###
CONFIG_EXT2_FS=y
# CONFIG_DNOTIFY is not set
CONFIG_TMPFS=y
CONFIG_CRAMFS=y
CONFIG_ROMFS_FS=y
CONFIG_NFS_FS=y
CONFIG_CIFS=y
CONFIG_CIFS_STATS=y
CONFIG_CIFS_STATS2=y

CONFIG_DEBUG_INFO=y
CONFIG_DEBUG_SLAB=y

CONFIG_DETECT_HUNG_TASK=y
CONFIG_DEBUG_SPINLOCK=y

CONFIG_KGDB=y
CONFIG_KGDB_TESTS=y
CONFIG_KGDB_KDB=y

CONFIG_EARLY_PRINTK=y
CONFIG_KEYS=y
CONFIG_ENCRYPTED_KEYS=y
```
